hm: homerow_mods {
    compatible = "zmk,behavior-hold-tap";
    label = "HOMEROW_MODS";
    #binding-cells = <2>;
    tapping-term-ms = <200>;
    quick_tap_ms = <175>;
    flavor = "tap-preferred";
    bindings = <&kp>, <&kp>;
};